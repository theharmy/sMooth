## boards/shields/sMooth/Kconfig.shield
```kconfig
config SHIELD_smooth_LEFT
	def_bool $(shields_list_contains,smooth_left)

config SHIELD_sMooth_RIGHT
	def_bool $(shields_list_contains,smooth_right)
```

## boards/shields/smooth/Kconfig.defconfig
```kconfig
if SHIELD_smooth_LEFT

# Name must be less than 16 characters long!
config ZMK_KEYBOARD_NAME
    default "smooth"

config ZMK_SPLIT_ROLE_CENTRAL
    default y

endif

if SHIELD_smooth_LEFT || SHIELD_smooth_RIGHT

config ZMK_SPLIT
    default y

config ZMK_BLE
    default y

endif
```
